## conf/layer.conf
```bitbake
# We have a conf and classes directory, append to BBPATH
BBPATH .= ":${LAYERDIR}"

# We have a recipes directory, add to BBFILES
BBFILES += "${LAYERDIR}/recipes*/*/*.bb ${LAYERDIR}/recipes*/*/*.bbappend"

BBFILE_COLLECTIONS += "imx-edgescale-layer"
BBFILE_PATTERN_imx-edgescale-layer := "^${LAYERDIR}/"
BBFILE_PRIORITY_imx-edgescale-layer = "5"

LAYERSERIES_COMPAT_imx-edgescale-layer = "sumo thud warrior"

# Add the NXP-specific licenses into the metadata
LICENSE_PATH += "${LAYERDIR}/custom-licenses"
PREFERRED_VERSION_openssl10 = "1.0.2p"

HOSTTOOLS_NONFATAL_append = " whoami"
```
